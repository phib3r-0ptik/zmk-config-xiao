// dactyl_cc_left.overlay

#include "dactyl_cc.dtsi" // Notice that the main dtsi files are included in the overlay.

&kscan0 {
    col-gpios
        //= <&xiao_d 1  GPIO_ACTIVE_HIGH>  // Col 0
        //, <&xiao_d 2  GPIO_ACTIVE_HIGH>  // Col 1
        //, <&xiao_d 6  GPIO_ACTIVE_HIGH>  // Col 2
        //, <&xiao_d 7  GPIO_ACTIVE_HIGH>  // Col 3
        //, <&xiao_d 8  GPIO_ACTIVE_HIGH>  // Col 4
        //, <&xiao_d 10 GPIO_ACTIVE_HIGH>  // Col 5
        = <&gpio0 3   GPIO_ACTIVE_LOW>  // Col 0
        , <&gpio0 28  GPIO_ACTIVE_LOW>  // Col 1
        , <&gpio1 11  GPIO_ACTIVE_LOW>  // Col 2
        , <&gpio1 12  GPIO_ACTIVE_LOW>  // Col 3
        , <&gpio1 13  GPIO_ACTIVE_LOW>  // Col 4
        , <&gpio1 15 GPIO_ACTIVE_LOW>  // Col 5
        ;
};


///* Use unique pins for every row/column */
//row-gpios
//    = <&gpio0 9  (GPIO_ACTIVE_HIGH | GPIO_PULL_DOWN)> // Row 0 (D9)
//    , <&gpio0 10 (GPIO_ACTIVE_HIGH | GPIO_PULL_DOWN)> // Row 1 (D10)
//    , <&gpio0 2  (GPIO_ACTIVE_HIGH | GPIO_PULL_DOWN)> // Row 2 (D0)
//    , <&gpio0 29 (GPIO_ACTIVE_HIGH | GPIO_PULL_DOWN)> // Row 3 (D3)
//    , <&gpio0 4  (GPIO_ACTIVE_HIGH | GPIO_PULL_DOWN)> // Row 4 (D4)
//    , <&gpio0 5  (GPIO_ACTIVE_HIGH | GPIO_PULL_DOWN)> // Row 5 (D5)
//    ;
//
//&kscan0 {
//    col-gpios
//        = <&gpio0 3  GPIO_ACTIVE_HIGH> // Col 0 (D1)
//        , <&gpio0 28 GPIO_ACTIVE_HIGH> // Col 1 (D2)
//        , <&gpio1 11 GPIO_ACTIVE_HIGH> // Col 2 (D6) - FIXED: Pointed to Port 1
//        , <&gpio1 12 GPIO_ACTIVE_HIGH> // Col 3 (D7) - FIXED: Pointed to Port 1
//        , <&gpio1 13 GPIO_ACTIVE_HIGH> // Col 4 (D8) - FIXED: Pointed to Port 1
//        /* MOVE YOUR D10 WIRE: You must move the wire currently on D10 
//           to a free pin like D0 (gpio0 2) or D2 (gpio0 28) if available. */
//        , <&gpio0 2  GPIO_ACTIVE_HIGH> // Col 5 (Example: Move wire to D0)
//        ;
//};
